#include <asm/memlayout.h>

ENTRY (_start)

SECTIONS
{
	. = __KERNEL_VIRTBASE + __KERNEL_PHYSBASE;
	/* Add a symbol that indicates the start address of the kernel. */
	.text ALIGN (4K) : AT (V2PL(ADDR(.text)))
	{
		__KERNEL_START = .;
		KEEP(*(.multiboot*))
		*(.text)
	}
	.rodata ALIGN (4K) : AT (V2PL(ADDR(.rodata)))
	{
		*(.rodata)
	}
	.data ALIGN (4K) : AT (V2PL(ADDR(.data)))
	{
		*(.data)
	}

	. = ALIGN(8);
	__bug_table ALIGN(8) : AT (V2PL(ADDR(__bug_table)))
	{
		__BUG_TABLE_START = .;
		KEEP(*(__bug_table));
		__BUG_TABLE_END = .;
	}

	.bss ALIGN (4K) : AT (V2PL(ADDR(.bss)))
	{
		*(COMMON)
		*(.bss)
		*(.bootstrap_stack)
	}
	/* Add a symbol that indicates the end address of the kernel. */
	__KERNEL_END = .;
}
